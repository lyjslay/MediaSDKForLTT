/dts-v1/;
#include "cv181x_base_arm.dtsi"
#include "cv181x_asic_bga.dtsi"
#include "cv181x_asic_emmc.dtsi"
#include "cv181x_default_memmap.dtsi"

/ {
	i2c1gpio: i2c1-gpio {
		compatible = "i2c-gpio";
		sda-gpios = <&portb 21 (GPIO_ACTIVE_HIGH | GPIO_OPEN_DRAIN)>;
		scl-gpios = <&portb 20 (GPIO_ACTIVE_HIGH | GPIO_OPEN_DRAIN)>;
		#size-cells = <0x0>;
		#address-cells = <0x1>;
		i2c-gpio,delay-us = <5>;
		status = "okay";
		gt9xx: gt9xx@5d {
		   compatible = "goodix,gt9xx";
		   reg = <0x5d>;
		   status = "okay";
	   };
	};
};

&wifisd {
	status = "okay";
};