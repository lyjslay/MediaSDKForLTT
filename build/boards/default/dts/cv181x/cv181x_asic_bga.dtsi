&dac{
	mute-gpio-r = <&porta 30 GPIO_ACTIVE_LOW>;
};

/ {
    /delete-node/ i2c@04000000;
	/delete-node/ i2s@04110000;
	/delete-node/ i2s@04120000;
	/delete-node/ sound_ext1;
	/delete-node/ sound_ext2;
	/delete-node/ sound_PDM;
};
