## cpsl/hal/screen/Kconfig
```kconfig
menu "Screen options"

config SCREEN
	bool "Enable SCREEN"
	help
		Say Y if you want to enable WIFI.
if SCREEN
	choice
		prompt "Screen type"
		default CONFIG_SCREEN_HX8394

	config SCREEN_HX8394
		bool "Enable screen HX8394"
		help
			Say Y if you want to enable screen HX8394.

	config SCREEN_ST7789P3SPI
			bool "Enable screen ST7789P3SPI"
			help
				Say Y if you want to enable screen ST7789P3SPI.

	config SCREEN_OTA5182
		bool "Enable screen OTA5182"
		help
			Say Y if you want to enable screen OTA5182.

	config SCREEN_ST7796S
		bool "Enable screen ST7796S"
		help
			Say Y if you want to enable screen ST7796S.

	config SCREEN_ST7789
		bool "Enable screen ST7789"
		help
			Say Y if you want to enable screen ST7789.

	config SCREEN_ST7796S_RGB16BIT
		bool "Enable screen ST7796S_RGB16BIT"
		help
			Say Y if you want to enable screen ST7796S_RGB16BIT.

	config SCREEN_OTA7290B
		bool "Enable screen OTA7290B"
		help
			Say Y if you want to enable screen OTA7290B.

	config SCREEN_ILI8961
		bool "Enable screen ILI8961"
		help
			Say Y if you want to enable screen ILI8961.

	config SCREEN_OTA7290B_MIPI11INCH
		bool "Enable screen OTA7290B_MIPI11INCH"
		help
			Say Y if you want to enable screen OTA7290B_MIPI11INCH.

	config SCREEN_ICNL9707
		bool "Enable screen ICNL9707"
		help
			Say Y if you want to enable screen ICNL9707.

	config SCREEN_EK79007
		bool "Enable screen EK79007"
		help
			Say Y if you want to enable screen EK79007.

	config SCREEN_ICN9707
		bool "Enable screen ICN9707"
		help
			Say Y if you want to enable screen ICN9707.

	config SCREEN_ST7701S
			bool "Enable screen ST7701S"
			help
				Say Y if you want to enable screen ST7701S.

    config SCREEN_GC9503V
        bool "Enable screen GC9503V"
        help
            Say Y if you want to enable screen 9503V.

    config SCREEN_GC9503V_W820
            bool "Enable screen GC9503V_W820"
            help
                Say Y if you want to enable screen GC9503V_W820.
    config SCREEN_GC9503V_W960
            bool "Enable screen GC9503V_W960"
            help
                Say Y if you want to enable screen GC9503V_W960.
    config SCREEN_NV3049E
		bool "Enable screen NV3049E"
		help
		Say Y if you want to enable screen NV3049E.

	config SCREEN_I80ST7789
		bool "Enable screen I80ST7789"
		help
		Say Y if you want to enable screen I80ST7789.

	config SCREEN_JD9165A
		bool "Enable screen JD9165A"
		help
		Say Y if you want to enable screen JD9165A.

	config SCREEN_FL7707N
		bool "Enable screen FL7707N"
		help
		Say Y if you want to enable screen FL7707N.

	config SCREEN_LTD600
		bool "Enable screen LTD600"
		help
		Say Y if you want to enable screen LTD600.
	endchoice

endif

endmenu
```

## cpsl/hal/touchpad/Kconfig
```kconfig
menu "Touchpad options"

config TOUCHPAD
	bool "Enable TOUCHPAD"
	help
		Say Y if you want to enable TOUCHPAD.

if TOUCHPAD

	choice
		prompt "TOUCHPAD type"
		default CONFIG_TOUCHPAD_GT9XX

	config TOUCHPAD_GT9XX
		bool "Enable TOUCHPAD GT9XX"
		help
			Say Y if you want to enable touchpad GT9XX.

endchoice

endif

endmenu
```

## cpsl/hal/watchdog/Kconfig
```kconfig
#
# For a description of the syntax of this configuration file,
# see Documentation/kbuild/kconfig-language.txt.
#
#comment "Device Configuration"

config WATCHDOG
	bool "Enable WATCHDOG"
	help
	  Say Y if you want to enable WATCHDOG.
```

## cpsl/hal/wifi/Kconfig
```kconfig
menu "Wifi options"

config WIFI
	bool "Enable WIFI"
	help
		Say Y if you want to enable WIFI.

if WIFI
	choice
		prompt "Wifi type"
		default CONFIG_WIFI_RTL8189


	config WIFI_RTL8189
		bool "Enable Wifi RTL8189"
		help
			Say Y if you want to enable wifi RTL8189.

	config WIFI_HI3881
		bool "Enable Wifi HI3881"
		help
			Say Y if you want to enable wifi HI3881.

	config WIFI_AP6201BM
		bool "Enable wifi AP6201BM"
		help
			Say Y if you want to enable wifi AP6201BM.

    config WIFI_RTL8188
		bool "Enable wifi RTL8188"
		help
			Say Y if you want to enable wifi RTL8188.

	config WIFI_AIC8800
		bool "Enable Wifi AIC8800"
		help
			Say Y if you want to enable wifi AIC8800.	
	endchoice
endif

endmenu
```

## cpsl/mmf/Kconfig
```kconfig
menu "Sensor options"

choice
	prompt "Sensor Dev 0"
	default SNS0_NONE
	config SNS0_NONE
		bool "none"
	config SNS0_GCORE_GC4653
		bool "gcore_gc4653"
	config SNS0_GCORE_GC02M1
		bool "gcore_gc02m1"
	config SNS0_GCORE_GC02M1_SLAVE
		bool "gcore_gc02m1_slave"
	config SNS0_GCORE_GC1084
		bool "gcore_gc1084"
	config SNS0_GCORE_GC1054
		bool "gcore_gc1054"
	config SNS0_GCORE_GC2053
		bool "gcore_gc2053"
	config SNS0_GCORE_GC2053_1L
		bool "gcore_gc2053_1l"
	config SNS0_GCORE_GC2083
		bool "gcore_gc2083"
	config SNS0_GCORE_GC2093
		bool "gcore_gc2093"
	config SNS0_SONY_IMX307
		bool "sony_imx307"
	config SNS0_SONY_IMX327
		bool "sony_imx327"
	config SNS0_SONY_IMX335
		bool "sony_imx335"
	config SNS0_SONY_IMX662
		bool "sony_imx662"
	config SNS0_CISTA_C4390
		bool "cista_c4390"
	config SNS0_GCORE_GC4023
		bool "gcore_gc4023"
	config SNS0_CISTA_C2395
		bool "cista_c2395"
	config SNS0_CISTA_C4395
		bool "cista_c4395"
	config SNS0_PIXELPLUS_PR2020
		bool "pixelplus_pr2020"
	config SNS0_TECHPOINT_TP9950
		bool "techpoint_tp9950"
	config SNS0_TECHPOINT_TP9963
		bool "techpoint_tp9963"
	config SNS0_TECHPOINT_TP9963_2CH
		bool "techpoint_tp9963_2ch"
	config SNS0_PIXELPLUS_XS9950
		bool "pixelplus_xs9950"
	config SNS0_PIXELPLUS_XS9951
		bool "pixelplus_xs9951"
	config SNS0_NEXTCHIP_N5
		bool "nextchip_n5"
	config SNS0_OV_OS5648
		bool "ov_os5648"

endchoice
choice
	prompt "Sensor Dev 1"
	depends on !SNS0_NONE
	default SNS1_NONE
	config SNS1_NONE
		bool "none"
	config SNS1_GCORE_GC4653
		bool "gcore_gc4653"
	config SNS1_GCORE_GC02M1
		bool "gcore_gc02m1"
	config SNS1_GCORE_GC02M1_SLAVE
		bool "gcore_gc02m1_slave"
	config SNS1_GCORE_GC1084
		bool "gcore_gc1084"
	config SNS1_GCORE_GC2053
		bool "gcore_gc2053"
	config SNS1_GCORE_GC2053_1L
		bool "gcore_gc2053_1l"
	config SNS1_GCORE_GC2083
		bool "gcore_gc2083"
	config SNS1_GCORE_GC2093
		bool "gcore_gc2093"
	config SNS1_SONY_IMX307
		bool "sony_imx307"
	config SNS1_SONY_IMX327
		bool "sony_imx327"
	config SNS1_SONY_IMX335
		bool "sony_imx335"
	config SNS1_SONY_IMX662
		bool "sony_imx662"
	config SNS1_GCORE_GC1054
		bool "gcore_gc1054"
	config SNS1_CISTA_C4390
		bool "cista_c4390"
	config SNS1_GCORE_GC4023
		bool "gcore_gc4023"
	config SNS1_CISTA_C2395
		bool "cista_c2395"
	config SNS1_CISTA_C4395
		bool "cista_c4395"
	config SNS1_PIXELPLUS_PR2020
		bool "pixelplus_pr2020"
	config SNS1_TECHPOINT_TP9950
		bool "techpoint_tp9950"
	config SNS1_TECHPOINT_TP9963
		bool "techpoint_tp9963"
	config SNS1_TECHPOINT_TP9963_2CH
		bool "techpoint_tp9963_2ch"
	config SNS1_PIXELPLUS_XS9950
		bool "pixelplus_xs9950"
	config SNS1_PIXELPLUS_XS9951
		bool "pixelplus_xs9951"
	config SNS1_NEXTCHIP_N5
		bool "nextchip_n5"
	config SNS1_OV_OS5648
		bool "ov_os5648"

endchoice
choice
	prompt "Sensor Dev 2"
	default SNS2_NONE
	depends on !SNS1_NONE
	config SNS2_NONE
		bool "none"
	config SNS2_PIXELPLUS_PR2020
		bool "pixelplus_pr2020"
	config SNS2_TECHPOINT_TP9950
		bool "techpoint_tp9950"
	config SNS2_NEXTCHIP_N5
		bool "nextchip_n5"
	config SNS2_PIXELPLUS_XS9950
		bool "pixelplus_xs9950"
	config SNS2_PIXELPLUS_XS9951
		bool "pixelplus_xs9951"

endchoice

endmenu

menu "MMF options"
# SBC Enable
config SBC
	bool "Enable SBC"
		default y
	help
	  Say Y if you want to enable SBC.
endmenu
```

## cpsl/tpu/Kconfig
```kconfig
#
# For a description of the syntax of this configuration file,
# see Documentation/kbuild/kconfig-language.txt.
#
#comment "Device Configuration"

config TPU
	bool "Enable TPU"
	help
	  Say Y if you want to enable TPU.
```

## framework/components/Kconfig
```kconfig
menu "Components options"


config COMPONENTS_MEMORY_ALLOCATOR
	bool "MemoryAllocator Component"
	help
	  Say Y if you want to enable MemoryAllocator Component.

config COMPONENTS_RINGBUFFER
	bool "Ringbuffer Component"
	select COMPONENTS_MEMORY_ALLOCATOR
	help
	  Say Y if you want to enable Ringbuffer Component.

config COMPONENTS_DEMUXER
	bool "Demuxer Component"
	help
	  Say Y if you want to enable Demuxer Component.

config COMPONENTS_MUXER
	bool "Muxer Component"
	help
	  Say Y if you want to enable Muxer Component.

config FLUSH_MOOV_STREAM
	bool "Flush Moov Stream"
	depends on COMPONENTS_MUXER
	help
		Say Y if you want to enable Flush Moov Stream.

config COMPONENTS_PLAYER
	bool "Player Component"
	select COMPONENTS_DEMUXER
	select COMPONENTS_MEMORY_ALLOCATOR
	select COMPONENTS_THUMBNAIL_EXTRACTOR
	help
	  Say Y if you want to enable Player Component.

config COMPONENTS_FILE_RECOVER
	bool "File_recover Component"
	help
	  Say Y if you want to enable File_recover Component.

config COMPONENTS_THUMBNAIL_EXTRACTOR
	bool "Thumbnail_Extractor Component"
	help
	  Say Y if you want to enable Thumbnail_Extractor Component.

config COMPONENTS_RECORDER
	bool "Record Component"
	select COMPONENTS_MUXER
	select COMPONENTS_RINGBUFFER
	help
	  Say Y if you want to enable Recorder Component.

config COMPONENTS_EVENT_REC_FILE_COPY_FROM_NORM
	bool "Event Record File"
    depends on COMPONENTS_RECORDER
	help
	  Say Y if you want to enable event record file copy from normal record.

config COMPONENTS_ONVIF
	bool "Onvif Component"
	default n
	help
	  Say Y if you want to enable Onvif Component.

config COMPONENTS_PERF
	bool "Perf Component"
	default n
	help
	  Say Y if you want to enable perf Component.

endmenu
```

## framework/services/Kconfig
```kconfig
menu "Services options"

config SERVICES_AUDIO
	bool "Audio Rec Service"
	help
		 Say Y if you want to enable Audio Rec Service

config SERVICES_SUBVIDEO
	bool "Rec/Rtsp Subvideo Service"
	help
		 Say Y if you want to enable Subvideo Rec/Rtsp Service

config SERVICES_IMAGE_VIEWER
	bool "Image_viewer Rec Service"
	help
		 Say Y if you want to enable Image_viewer Rec Service

config SERVICES_LIVEVIEW
	bool "Liveview Rec Service"
	help
		 Say Y if you want to enable Liveview Rec Service

config SERVICES_PLAYER
	bool "Player Rec Service"
	help
		 Say Y if you want to enable Player Rec Service

if SERVICES_PLAYER
	config Player_Subvideo
		bool "Enable Player Subvideo"
		help
			Say Y if you want to enable Player Subvideo.
endif

config SERVICES_RECORD
	bool "Record Rec Service"
	help
		 Say Y if you want to enable Record Rec Service

config SERVICES_PHOTO
	bool "Photo Service"
	help
		 Say Y if you want to enable Photo Service

config SERVICES_RTSP
	bool "RTSP Rec Service"
	help
		 Say Y if you want to enable RTSP Rec Service

config ENABLE_SNAP
	bool "Snap Service"
	help
		 Say Y if you want to enable Snap Service

config SERVICES_STORAGE
	bool "Storage Rec Service"
	help
		 Say Y if you want to enable Storage Rec Service

config SERVICES_SPEECH
	bool "Speech Service"
	help
		Say Y if you want to enable Service_Speech.

if SERVICES_SPEECH
	choice
		prompt "Model type"
		default CONFIG_SPEECH_CARDV


	config SPEECH_CARDV
		bool "Enable Speech Cardv"
		help
			Say Y if you want to enable Model Cardv.
	endchoice
endif

config SERVICES_ADAS
	bool "ADAS Service"
	help
		Say Y if you want to enable Service_ADAS.

if SERVICES_ADAS

	config ADAS_LABEL_CAR
		bool "Enabel ADAS CAR Label"
		help
		  Say Y if you want to enable ADAS CAR Label.

	config ADAS_LABEL_LANE
	bool "Enabel ADAS LANE Label"
	help
		Say Y if you want to enable ADAS LANE Label.

	config ADAS_LABEL_OSD
	depends on !(ADAS_LABEL_CAR || ADAS_LABEL_LANE)
		bool "Enabel ADAS Label via OSD"
		help
		  Say Y if you want to enable ADAS Label via OSD.

endif

config SERVICES_QRCODE
	bool "Decoding QRCode Service"
	help
		Say Y if you want to enable decoding QRCode
choice
	prompt "Dec QRCode Lib"
	default ZBAR
	depends on SERVICES_QRCODE
	config ZBAR
		bool "Zbar"
endchoice

endmenu
```

## out/build_boot/workspace/multi.its
```
/*
 * U-Boot uImage source file with multiple kernels, ramdisks and FDT blobs
 */

/dts-v1/;

/ {
	description = "Various kernels, ramdisks and FDT blobs";
	#address-cells = <2>;

	images {
		kernel-1 {
			description = "cvitek kernel";
			data = /incbin/("./Image.lzma");
			type = "kernel";
			arch = "arm";
			os = "linux";
			compression = "lzma";
			load = <0x0 0x80108000>;
			entry = <0x0 0x80108000>;
			hash-2 {
				algo = "crc32";
			};
		};


		/*FDT*/
    
        fdt-cv1811ha_wevb_0007a_spinor {
            description = "cvitek device tree - cv1811ha_wevb_0007a_spinor";
            data = /incbin/("./cv1811ha_wevb_0007a_spinor.dtb");
            type = "flat_dt";
            arch = "arm";
            compression = "none";
            hash-1 {
                algo = "sha256";
            };
        };



	};

	/*CFG*/
    configurations {
        
        config-cv1811ha_wevb_0007a_spinor {
            description = "boot cvitek system with board cv1811ha_wevb_0007a_spinor";
            kernel = "kernel-1";
            fdt = "fdt-cv1811ha_wevb_0007a_spinor";
        };

    };


};
```
