## Kconfig
```kconfig
#
# For a description of the syntax of this configuration file,
# see Documentation/kbuild/kconfig-language.txt.
#
mainmenu "CViTek MediaSDK Configuration"
menu "CViTek BSP Configuration"

choice
	prompt "Arch Type"
	default RISCV
	config RISCV
		bool "riscv"
	config ARM
		bool "arm"
endchoice

menu "Compile-time checks and compiler options"

choice
	prompt "C library"
	default TOOLCHAIN_GLIBC_RISCV64

config TOOLCHAIN_GLIBC_RISCV64
	bool "glibc library for user mode application on riscv64"
	help
	  glibc library for riscv64(RISCV64).

config TOOLCHAIN_MUSL_RISCV64
	bool "musl library for user mode application on riscv64"
	help
	  musl library for riscv64(RISCV64).
	  select on compiler option through menuconfig
	  default value is false.

config TOOLCHAIN_GLIBC_ARM
	bool "glibc library for user mode application on arm"
	help
	  glibc library for arm(arm32).

endchoice

config CROSS_COMPILE
	string
	default "riscv64-unknown-linux-gnu-" if TOOLCHAIN_GLIBC_RISCV64
	default "riscv64-unknown-linux-musl-" if TOOLCHAIN_MUSL_RISCV64
	default "arm-linux-gnueabihf-" if TOOLCHAIN_GLIBC_ARM
	help
	  Cross compile toolchain prefix for middleware.
	  This will modify by TOOLCHAN_XLIBC

config CROSS_COMPILE_KERNEL
	string
	default "riscv64-unknown-linux-gnu-" if TOOLCHAIN_GLIBC_RISCV64
	default "riscv64-unknown-linux-musl-" if TOOLCHAIN_MUSL_RISCV64
	default "arm-linux-gnueabihf-" if TOOLCHAIN_GLIBC_ARM
	help
	  Cross compile toolchain prefix for linux kernel.
	  You don't need to set this unless you want the configured kernel build
	  directory.

config CROSS_COMPILE_UBOOT
	string
	default "riscv64-unknown-linux-gnu-" if TOOLCHAIN_GLIBC_RISCV64
	default "riscv64-unknown-linux-musl-" if TOOLCHAIN_MUSL_RISCV64
	default "aarch64-linux-gnu-" if TOOLCHAIN_GLIBC_ARM
	help
	  Cross compile toolchain prefix for linux kernel.
	  You don't need to set this unless you want the configured kernel build
	  directory.

config STATIC
	bool "Build static binary (no shared libs)"
	default n
	help
	If you want to build a static binary, which does not use
	or require any shared libraries, enable this option.
	Static binaries are larger, but do not require functioning
	dynamic libraries to be present, which is important if used
	as a system rescue tool.

choice
	prompt "Compiler optimization level"
	default CONFIG_CC_OPTIMIZE_FOR_PERFORMANCE

config CC_OPTIMIZE_FOR_PERFORMANCE
	bool "Optimize for performance"
	help
	  This is the default optimization level for the kernel, building
	  with the "-O2" compiler flag for best performance and most
	  helpful compile-time warnings.

config CC_OPTIMIZE_FOR_SIZE
	bool "Optimize for size"
	help
	  Enabling this option will pass "-Os" instead of "-O2" to
	  your compiler resulting in a smaller kernel.

	  If unsure, say N.

endchoice

config DEBUG_INFO
	bool "Compile the application with debug info"
	help
          If you say Y here the resulting application binary will include
	  debugging info resulting in a larger application binary.
	  This adds debug symbols to the application (gcc -g), and
	  is needed if you want to debug your application with gdb.
	  Say Y here only if you plan to debug the application.

	  If unsure, say N.

config DEBUG_INFO_REDUCED
	bool "Reduce debugging information"
	depends on DEBUG_INFO
	help
	  If you say Y here gcc is instructed to generate less debugging
	  information for structure types. This means that tools that
	  need full debugging information (like gdb or systemtap) won't
	  be happy. But if you merely need debugging information to
	  resolve line numbers there is no loss. Advantage is that
	  build directory object sizes shrink dramatically over a full
	  DEBUG_INFO build and compile times are reduced too.
	  Only works with newer gcc versions.

config DEBUG_INFO_SPLIT
	bool "Produce split debuginfo in .dwo files"
	depends on DEBUG_INFO
	help
	  Generate debug info into separate .dwo files. This significantly
	  reduces the build directory size for builds with DEBUG_INFO,
	  because it stores the information only once on disk in .dwo
	  files instead of multiple times in object files and executables.
	  In addition the debug information is also compressed.

	  Requires recent gcc (4.7+) and recent gdb/binutils.
	  Any tool that packages or reads debug information would need
	  to know about the .dwo files and include them.
	  Incompatible with older versions of ccache.

config DEBUG_INFO_DWARF4
	bool "Generate dwarf4 debuginfo"
	depends on DEBUG_INFO
	help
	  Generate dwarf4 debug info. This requires recent versions
	  of gcc and gdb. It makes the debug information larger.
	  But it significantly improves the success of resolving
	  variables in gdb on optimized code.


endmenu

endmenu

source "build/boards/Kconfig"
source "platform/Kconfig"
source "cpsl/mmf/Kconfig"
source "cpsl/hal/Kconfig"
source "framework/components/Kconfig"
source "framework/services/Kconfig"
source "applications/Kconfig"

config ENABLE_ISP_PQ_TOOL
	bool "Enable ISP PQ Tool"
	select SERVICES_RTSP
	help
	  Say Y if you want to enable ISP PQ Tool.
```

## applications/Kconfig
```kconfig
menu "Application options"

menu "Video Md Configuration"

config VIDEO_MD
	bool "Video Md"
	help
		Say Y if you want to enable Video Md.
endmenu

menu "Reset Mode After AHD Hotplug"
    config RESET_MODE_AHD_HOTPLUG
	bool "Reset Mode After AHD Hotplug"
	help
		Say Y if you want to enable Reset Mode After AHD Hotplug.
endmenu

menu "ISP IRCUT Configuration"
config ISP_IR_CUT
	bool "isp ir_cut"
	help
		Say Y if you want to enable push isp expinfo.
endmenu

choice
	prompt "Application type"
	default CONFIG_APP_DASHCAM

config APP_DASHCAM
	bool "Dashcam Application"
	help
	  Say Y if you want to enable Dashcam Application.

if APP_DASHCAM

choice
	prompt "DashCam type"
	default REARVIEW
config CARRECORDER
	bool "CarRecorder"
config REARVIEW
	bool "RearView"
config NONESCREEN
	bool "NoneScreen"
endchoice

choice
	prompt "NetProtocol type"
	default NETPROTOCOL_CJSON
config NETPROTOCOL_XML
	bool "NetProtocol_Xml"
config NETPROTOCOL_CGI
	bool "NetProtocol_Cgi"
config NETPROTOCOL_CJSON
	bool "NetProtocol_cJson"
endchoice

if (CARRECORDER || REARVIEW)
menu "UI Configuration"

if CARRECORDER
choice
	prompt "UI Packet"
	default CARRECORDER_TURNKEY
config CARRECORDER_TURNKEY
	bool "CarRecorder turnkey"
endchoice
endif

if REARVIEW
choice
	prompt "UI Packet"
	default REARVIEW_TURNKEY
config REARVIEW_TURNKEY
    bool "RearView turnkey"
endchoice
endif

config UI_RESPATH
	string "Ui res path"
	  help
	  	Ui res path.

config UI_WIDTH
	int "Ui width"
	help
	  Ui Width.

config UI_HEIGHT
	int "Ui height"
	  help
		Ui Height.

config FB_DUAL_BUFFER
	bool "FB dual buffer mode"
	help
	  Say Y if you want to enable dual buffer mode.

choice
	prompt "FB pixdepth"
	default FB_PIX_DEPTH_16
	config FB_PIX_DEPTH_16
		bool "FB_PIX_DEPTH_16"
	config FB_PIX_DEPTH_32
		bool "FB_PIX_DEPTH_32"
endchoice

choice
	prompt "FB pixformat"
	default FB_ARGB4444
	config FB_ARGB4444
		bool "FB_ARGB4444"
		depends on FB_PIX_DEPTH_16
	config FB_ARGB1555
		bool "FB_ARGB1555"
		depends on FB_PIX_DEPTH_16
	config FB_ARGB8888
		bool "FB_ARGB8888"
		depends on FB_PIX_DEPTH_32
endchoice

endmenu
endif

endif
endchoice

endmenu
```

## build/boards/Kconfig
```kconfig
menu "CViTek Board Configuration"
choice
	prompt "Chip Type"
	default CV1811H
	config CV1810C
		bool "cv1810c"
	config CV1811C
		bool "cv1811c"
	config CV1812CP
		bool "cv1812cp"
	config CV1811H
		bool "cv1811h"
	config CV1812H
		bool "cv1812h"
	config CV1811HA
		bool "cv1811ha"
	config CV1812HA
		bool "cv1812ha"
	config CV1801C
	    bool "cv1801c"
	config CV180ZB
	    bool "cv180zb"
	config CV1801B
	    bool "cv1801b"
	config CV1800B
	    bool "cv1800b"
	config CV1800C
	    bool "cv1800c"
endchoice

choice
	prompt "Board type"
	default WEVB_0007A
	config WEVB_0007A
		bool "wevb_0007a"
	config WEVB_0006A
		bool "wevb_0006a"
	config WDMB_0006A
		bool "wdmb_0006a"
	config WEVB_0008A
		bool "wevb_0008a"
	config WEVB_0009A
	    bool "wevb_0009a"
endchoice

choice
	prompt "Arch define"
	default 64BIT
	config 64BIT
		bool "64bit"
	config 32BIT
		bool "32bit"
endchoice

choice
	prompt "DDR size"
	default DDR_128M
	config DDR_64M
		bool "64M"
	config DDR_128M
		bool "128M"
	config DDR_256M
		bool "256M"
	config DDR_512M
		bool "512M"
endchoice

choice
	prompt "DDR Config"
	default CONFIG_DDR_CFG_ddr3_1866_x16

config CONFIG_DDR_CFG_ddr3_1866_x16
	bool "sel ddr date rate to 1866"
	help
	sel ddr date rate to 1866.

config CONFIG_DDR_CFG_ddr3_2133_x16
	bool "sel ddr date rate to 2133"
	help
	sel ddr date rate to 2133.

config CONFIG_DDR_CFG_ddr2_1333_x16
	bool "sel ddr date rate to 1333"
	help
	sel ddr date rate to 1333.

config CONFIG_DDR_CFG_ddr_auto_x16
	bool "sel ddr date rate auto"
	help
	sel ddr date rate to auto.

endchoice

config DDR_CFG
	string
	default "ddr3_1866_x16" if CONFIG_DDR_CFG_ddr3_1866_x16
	default "ddr3_2133_x16" if CONFIG_DDR_CFG_ddr3_2133_x16
	default "ddr2_1333_x16" if CONFIG_DDR_CFG_ddr2_1333_x16
	default "ddr_auto_x16" if CONFIG_DDR_CFG_ddr_auto_x16
	help
	  set ddr date rate

menu "Storage type"

choice
	prompt "Storage Config"
	config SPINAND
		bool "spinand"
	config SPINOR
		bool "spinor"
	config EMMC
		bool "emmc"
endchoice

menu "Nand flase setting"
	depends on SPINAND
	config NANDFLASH_BLOCKSIZE
		int "nand flash block size"
		default 131072
		help
		  set nand flash block size.

	config NANDFLASH_PAGESIZE
		int "nand flase page size"
		default 2048
		help
		  set nand flase page size.
endmenu

endmenu

config ENABLE_OD
	bool "Enable OD clk"
	help
		Say Y if you want to enable OD.

if ENABLE_OD
choice
	prompt "OD Config"
	default OD_CLK_SEL

config OD_CLK_SEL
	bool "Set OD clk"
	help
		Say Y if you want to enable all OD.

config VC_CLK_OVERDRIVE
	bool "Set VC OD clk"
	help
		Say Y if you want to enable VC OD.
endchoice
endif

config BOARD_DEBUG
	bool "Set board debug"
	default n
	help
		Say Y if you want to debug.

config BRANCH_NAME
	string "Set branch name"
	  help
	  	set branch name.

endmenu
```

## build/boards/cv181x/cv1812ha_wevb_0007a_emmc/u-boot/cvitek_cv1812ha_wevb_0007a_emmc_defconfig
```kconfig
CONFIG_ARM=y
CONFIG_SYS_MALLOC_F_LEN=0x100000
CONFIG_NR_DRAM_BANKS=1
CONFIG_DEFAULT_DEVICE_TREE="cv181x_asic"
CONFIG_IDENT_STRING=" cvitek_cv181x"
CONFIG_ARMV8_SET_SMPEN=y
CONFIG_TARGET_CVITEK_CV181X=y
CONFIG_DISTRO_DEFAULTS=y
CONFIG_FIT=y
# CONFIG_ARCH_FIXUP_FDT_MEMORY is not set
CONFIG_BOOTDELAY=1
# CONFIG_DISPLAY_CPUINFO is not set
# CONFIG_DISPLAY_BOARDINFO is not set
CONFIG_SYS_PROMPT="cv181x# "
# CONFIG_CMD_CONSOLE is not set
# CONFIG_CMD_XIMG is not set
# CONFIG_CMD_EDITENV is not set
# CONFIG_CMD_CRC32 is not set
# CONFIG_CMD_LZMADEC is not set
# CONFIG_CMD_UNLZ4 is not set
# CONFIG_CMD_UNZIP is not set
# CONFIG_CMD_LOADS is not set
CONFIG_CMD_MMC=y
# CONFIG_CMD_ITEST is not set
CONFIG_CMD_CACHE=y
CONFIG_CMD_CVI_SD_UPDATE=y
# CONFIG_ISO_PARTITION is not set
# CONFIG_EFI_PARTITION is not set
CONFIG_OF_CONTROL=y
CONFIG_NET_RANDOM_ETHADDR=y
CONFIG_DM=y
CONFIG_MMC=y
CONFIG_MMC_SDHCI=y
CONFIG_MMC_SDHCI_SDMA=y
CONFIG_MMC_SDHCI_CVITEK=y
CONFIG_MTD=y
# CONFIG_PHY_SMSC is not set
CONFIG_DM_ETH=y
CONFIG_ETH_DESIGNWARE=y
CONFIG_PHY_CVITEK=y
CONFIG_SYS_NS16550=y
CONFIG_SPI=y
CONFIG_LZ4=y
CONFIG_LZMA=y
# CONFIG_TOOLS_LIBCRYPTO is not setCONFIG_DM=y
CONFIG_DM_MMC=y
CONFIG_DM_GPIO=y
CONFIG_DWAPB_GPIO=y
CONFIG_DM_VIDEO=y
CONFIG_VIDEO_CVITEK=y
CONFIG_BOOTLOGO=
CONFIG_CMD_CVI_VO=y
CONFIG_DISPLAY=y
CONFIG_DISPLAY_CVITEK_MIPI=y
# CONFIG_DISPLAY_CVITEK_I80_HW=y
#CONFIG_DISPLAY_CVITEK_LVDS is not set
# CONFIG_ENV_IS_IN_SPI_FLASH=y
# CONFIG_CMD_CVI_JPEG=y
CONFIG_CMD_CVI_AHD=y
CONFIG_SPL_GPIO=y

CONFIG_DM_PWM=y
CONFIG_PWM_CVITEK=y
CONFIG_ENV_IS_IN_MMC=y
```

## cpsl/hal/Kconfig
```kconfig
menu "Peripheral options"

source "cpsl/hal/adc/Kconfig"
source "cpsl/hal/gpio/Kconfig"
source "cpsl/hal/key/Kconfig"
source "cpsl/hal/led/Kconfig"
source "cpsl/hal/gps/Kconfig"
source "cpsl/hal/pwm/Kconfig"
source "cpsl/hal/watchdog/Kconfig"
source "cpsl/tpu/Kconfig"
source "cpsl/hal/gsensor/Kconfig"
source "cpsl/hal/screen/Kconfig"
source "cpsl/hal/touchpad/Kconfig"
source "cpsl/hal/wifi/Kconfig"

endmenu
```

## cpsl/hal/adc/Kconfig
```kconfig
# ADC Enable

config ADC
	bool "Enable ADC"
	help
	  Say Y if you want to enable ADC.
```

## cpsl/hal/gpio/Kconfig
```kconfig
# GPIO Enable

config GPIO
	bool "Enable GPIO"
	help
	  Say Y if you want to enable GPIO.
```

## cpsl/hal/gps/Kconfig
```kconfig
# GPS Enable

config GPS
	bool "Enable GPS"
	help
	  Say Y if you want to enable GPS.
```

## cpsl/hal/gsensor/Kconfig
```kconfig
menu "Gsensor options"

config GSENSOR
	bool "Enable GSENSOR"
	help
		Say Y if you want to enable GSENSOR.

if GSENSOR

	choice
		prompt "Gsensor type"
		default CONFIG_GSENSOR_DA280
		default CONFIG_GSENSOR_DA380
		default CONFIG_GSENSOR_SC7A20E


	config GSENSOR_DA280
		bool "Enable GSENSOR DA280"
		help
			Say Y if you want to enable gsensor DA280.

	config GSENSOR_DA380
		bool "Enable GSENSOR DA380"
		help
			Say Y if you want to enable gsensor DA380.

	config GSENSOR_SC7A20E
		bool "Enable GSENSOR sc7a20e"
		help
			Say Y if you want to enable gsensor sc7a20e.

endchoice

endif

endmenu
```

## cpsl/hal/key/Kconfig
```kconfig
# KEY Enable

config KEY
	bool "Enable KEY"
	depends on ADC || GPIO
	help
	  Say Y if you want to enable key.
```

## cpsl/hal/led/Kconfig
```kconfig
# LED Enable

config LED
	bool "Enable LED"
	help
	  Say Y if you want to enable LED.
```

## cpsl/hal/pwm/Kconfig
```kconfig
# PWM Enable

config PWM
	bool "Enable PWM"
	help
	  Say Y if you want to enable PWM.
```
